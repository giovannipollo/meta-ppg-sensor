## meta-ppg-sensor/conf/layer.conf
```bitbake
# We have a conf and classes directory, add to BBPATH
BBPATH .= ":${LAYERDIR}"

# We have recipes-* directories, add to BBFILES
BBFILES += "${LAYERDIR}/recipes-*/*/*.bb \
            ${LAYERDIR}/recipes-*/*/*.bbappend"

BBFILE_COLLECTIONS += "meta-ppg-sensor"
BBFILE_PATTERN_meta-ppg-sensor = "^${LAYERDIR}/"
BBFILE_PRIORITY_meta-ppg-sensor = "6"

LAYERDEPENDS_meta-ppg-sensor = "core"
LAYERSERIES_COMPAT_meta-ppg-sensor = "dunfell"
```
